## examples/esp_idf/c3SuperMiniOLED/sdkconfig.defaults
```kconfig
# BadCodecPlayer sdkconfig.defaults
# ESP32-C3 Super Mini / SSD1306 72x40 I2C / BadCodec v0.6.0

# I2C ドライバ有効化
CONFIG_I2C_ENABLE_DEBUG_LOG=n

# FreeRTOS tick 1ms
CONFIG_FREERTOS_HZ=1000

# Flash 4MB
CONFIG_ESPTOOLPY_FLASHSIZE_4MB=y
CONFIG_ESPTOOLPY_FLASHSIZE="4MB"

# ログレベル (INFO)
CONFIG_LOG_DEFAULT_LEVEL_INFO=y
CONFIG_LOG_DEFAULT_LEVEL=3

# スタックサイズ (動画タスク用)
CONFIG_ESP_MAIN_TASK_STACK_SIZE=8192
```
